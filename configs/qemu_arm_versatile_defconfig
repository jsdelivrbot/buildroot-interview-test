## configs/qemu_arm_versatile_defconfig
```kconfig
BR2_arm=y
BR2_PACKAGE_HOST_LINUX_HEADERS_CUSTOM_4_5=y
BR2_TOOLCHAIN_BUILDROOT_WCHAR=y
BR2_TARGET_GENERIC_GETTY_PORT="ttyAMA0"
BR2_SYSTEM_DHCP="eth0"
BR2_LINUX_KERNEL=y
BR2_LINUX_KERNEL_CUSTOM_VERSION=y
BR2_LINUX_KERNEL_CUSTOM_VERSION_VALUE="4.5.3"
BR2_LINUX_KERNEL_USE_CUSTOM_CONFIG=y
BR2_LINUX_KERNEL_CUSTOM_CONFIG_FILE="board/qemu/arm-versatile/linux-4.5.config"
BR2_LINUX_KERNEL_DTS_SUPPORT=y
BR2_LINUX_KERNEL_INTREE_DTS_NAME="versatile-pb"
BR2_PACKAGE_BEEP=y
BR2_PACKAGE_SMEM=y
BR2_PACKAGE_PYTHON=y
BR2_TARGET_ROOTFS_EXT2=y
# BR2_TARGET_ROOTFS_TAR is not set
```

## package/beep/Config.in
```kconfig
config BR2_PACKAGE_BEEP
    bool "beep"
    default n
    help
        Simple tool to beep

        http://www.johnath.com/beep/
```

## package/smem/Config.in
```kconfig
config BR2_PACKAGE_SMEM
    bool "smem"
    default n
    depends on BR2_PACKAGE_PYTHON
    help
        The tool that can give numerous reports on memory usage on Linux systems
        
        https://www.selenic.com/smem/
```
